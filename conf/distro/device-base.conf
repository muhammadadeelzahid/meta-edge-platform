## conf/distro/device-base.conf
```bitbake
# Inherit settings from the default Yocto reference distro
require conf/distro/poky.conf

# Distro Identity
DISTRO = "device-base"
DISTRO_NAME = "Device Base Platform"
DISTRO_VERSION = "2.0.0"
DISTRO_CODENAME = "scarthgap"

DISTRO_FEATURES:append = " systemd usrmerge overlayfs"
VIRTUAL-RUNTIME_init_manager = "systemd"
DISTRO_FEATURES_BACKFILL_CONSIDERED += "sysvinit"
VIRTUAL-RUNTIME_initscripts = "systemd-compat-units"
```

## conf/layer.conf
```bitbake
# We have a conf and classes directory, add to BBPATH
BBPATH .= ":${LAYERDIR}"

# We have recipes-* directories, add to BBFILES
BBFILES += "${LAYERDIR}/recipes-*/*/*.bb \
            ${LAYERDIR}/recipes-*/*/*.bbappend"

BBFILE_COLLECTIONS += "meta-edge-platform"
BBFILE_PATTERN_meta-edge-platform = "^${LAYERDIR}/"
BBFILE_PRIORITY_meta-edge-platform = "6"

LAYERDEPENDS_meta-edge-platform = "core"
LAYERSERIES_COMPAT_meta-edge-platform = "scarthgap"
```
